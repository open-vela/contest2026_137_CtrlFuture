## app/ap3216c_test_app/Kconfig
```kconfig
#
# For a description of the syntax of this configuration file,
# see the file kconfig-language.txt in the NuttX tools repository.
#

config LVX_USE_DEMO_CONTEST2026_137_AP3216C_TEST_APP
	bool "Contest 2026 team 137 AP3216C I2C4 self-test"
	default n
	depends on STM32_I2C4 && I2C && I2C_DRIVER
	---help---
		Enable the contest 2026 team 137 AP3216C self-test
		(ap3216c_test).  Opens /dev/i2c4, software-resets the onboard
		AP3216C ambient-light/proximity/IR sensor at address 0x1e,
		enables all channels by writing 0x03 to its system-config
		register, and reads the register back.  PASSes iff every
		transfer ACKs and the register reads back 0x03 -- proof that
		the I2C4 bus transacts data in both directions against a real
		external slave (no jumper or instrument needed).  Requires
		STM32_I2C4 in the arch layer plus the I2C character driver.
```

## app/edgesight/Kconfig
```kconfig
/****************************************************************************
 * app/edgesight/Kconfig
 ****************************************************************************/

config APP_EDGESIGHT
	tristate "EdgeSight AI Edge Sentinel"
	default n
	---help---
		EdgeSight: AI-powered fall detection and surveillance terminal.
		Uses NPU for person detection and pose estimation,
		with multi-modal sensor fusion for decision making.

if APP_EDGESIGHT

config EDGESIGHT_PRIORITY
	int "EdgeSight main task priority"
	default 100

config EDGESIGHT_STACKSIZE
	int "EdgeSight main task stack size"
	default 4096

config EDGESIGHT_ENABLE_DISPLAY
	bool "Enable LCD display output"
	default y
	---help---
		Enable LTDC + GPU2D display rendering.

config EDGESIGHT_ENABLE_RECORDING
	bool "Enable H.264 event recording"
	default y
	---help---
		Enable H.264 hardware encoding and SD card recording.

config EDGESIGHT_ENABLE_NETWORK
	bool "Enable network services"
	default y
	---help---
		Enable MQTT alerts and RTSP streaming.

config EDGESIGHT_ENABLE_AUDIO
	bool "Enable audio detection"
	default n
	---help---
		Enable microphone input and sound event classification.

config EDGESIGHT_FALL_CONSECUTIVE_FRAMES
	int "Consecutive frames to confirm fall"
	default 3
	---help---
		Number of consecutive suspicious frames required
		before triggering a fall alert.

config EDGESIGHT_FALL_TORSO_ANGLE
	int "Torso angle threshold (degrees)"
	default 55
	---help---
		Torso angle from vertical above which a fall is suspected.

endif # APP_EDGESIGHT
```

## arch/arm/stm32n6/src/Kconfig
```kconfig
#
# For a description of the syntax of this configuration file,
# see the file kconfig-language.txt in the NuttX tools repository.
#

if ARCH_CHIP_STM32N6

menu "STM32N6 Chip Selection"

choice
	prompt "STM32N6 Chip Configuration"
	default ARCH_CHIP_STM32N647X0

config ARCH_CHIP_STM32N647X0
	bool "STM32N647X0"
	select ARCH_CORTEXM55
	select ARCH_HAVE_MPU
	select ARCH_HAVE_FPU
	select ARM_HAVE_MVE
	select ARMV8M_HAVE_ICACHE
	select ARMV8M_HAVE_DCACHE
	select ARMV8M_HAVE_ITCM
	select ARMV8M_HAVE_DTCM

endchoice

endmenu

menu "STM32N6 Clock Configuration"

config STM32N6_USE_HSE
	bool "Use HSE external oscillator"
	default n
	---help---
		Enable HSE (external high-speed oscillator) as clock source.
		If not set, HSI (64MHz internal RC) is used.

config STM32N6_HSE_FREQUENCY
	int "HSE frequency (Hz)"
	default 32000000
	depends on STM32N6_USE_HSE
	---help---
		Frequency of the external HSE oscillator in Hz.

config STM32N6_USE_PLL1
	bool "Enable PLL1 for system clock"
	default n
	depends on STM32N6_USE_HSE
	---help---
		Configure PLL1 to generate 800MHz from HSE, with AHB DIV4
		giving 200MHz conservative system clock. If not set, system
		runs directly from HSI or HSE.

endmenu

menu "STM32N6 Peripheral Selection"

config STM32_USART1
	bool "USART1"
	default n
	select USART1_SERIALDRIVER
	select ARCH_HAVE_SERIAL_TERMIOS

config STM32_USART2
	bool "USART2"
	default n
	select USART2_SERIALDRIVER
	select ARCH_HAVE_SERIAL_TERMIOS

config STM32_USART3
	bool "USART3"
	default n
	select USART3_SERIALDRIVER
	select ARCH_HAVE_SERIAL_TERMIOS

config STM32_IWDG
	bool "IWDG (Independent Watchdog)"
	default n
	---help---
		Enable the Independent Watchdog (IWDG) peripheral for
		system hang detection. Uses LSI 32kHz clock.

config STM32_I2C1
	bool "I2C1"
	default n
	select I2C
	---help---
		Enable I2C1 master mode driver (interrupt-driven).

config STM32_I2C2
	bool "I2C2"
	default n
	select I2C
	---help---
		Enable I2C2 master mode driver (interrupt-driven).

config STM32_EXTI
	bool "EXTI (Extended Interrupt)"
	default n
	---help---
		Enable the EXTI (Extended Interrupt and Event) controller
		driver. Supports GPIO pin edge-triggered interrupts for
		buttons, external events, and wakeup sources.

config STM32_RTC
	bool "RTC (Real-Time Clock)"
	default n
	select RTC_DATETIME
	---help---
		Enable the RTC peripheral for calendar date/time.
		Uses LSI ~32kHz clock source. Provides time for
		file system timestamps and alarm functionality.

config STM32_GPDMA
	bool "GPDMA (General Purpose DMA)"
	default n
	select DMA
	---help---
		Enable the GPDMA (General Purpose DMA) controller for
		memory-to-memory, memory-to-peripheral, and
		peripheral-to-memory transfers.

config STM32_SPI1
	bool "SPI1"
	default n
	select SPI
	---help---
		Enable SPI1 master mode driver.

config STM32_SPI2
	bool "SPI2"
	default n
	select SPI
	---help---
		Enable SPI2 master mode driver.

endmenu

endif
```
